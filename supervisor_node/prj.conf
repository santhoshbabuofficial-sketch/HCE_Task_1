## prj.conf
```kconfig
# ---- C++ support ------------------------------------------------------
CONFIG_CPP=y
CONFIG_STD_CPP20=y
CONFIG_NEWLIB_LIBC=y
CONFIG_GLIBCXX_LIBCPP=y
CONFIG_NEWLIB_LIBC_FLOAT_PRINTF=y

# ---- No heap allocation (Rule 1) --------------------------------------
CONFIG_HEAP_MEM_POOL_SIZE=0

# ---- Threading / stack watermarks (Rule 6) -----------------------------
CONFIG_THREAD_ANALYZER=y
CONFIG_THREAD_ANALYZER_AUTO=y
CONFIG_THREAD_NAME=y
CONFIG_MAIN_STACK_SIZE=2048

# ---- CAN-FD -------------------------------------------------------------
CONFIG_CAN=y
CONFIG_CAN_FD_MODE=y

# ---- GPIO (alarm LED) --------------------------------------------------
CONFIG_GPIO=y

# ---- Logging ----------------------------------------------------------
CONFIG_LOG=y
CONFIG_LOG_MODE_IMMEDIATE=y
CONFIG_CBPRINTF_FP_SUPPORT=y

# ---- Assertions ---------------------------------------------------------
CONFIG_ASSERT=y
```

## src/main.cpp
```c
/// @file main.cpp
/// @brief Supervisor Node entry point. Wires gpio_overlay -> CAN RX ->
///        supervisor_manager (Mediator) -> {alarm LED, RUN/STOP CAN TX}.
#include <zephyr/kernel.h>
#include <zephyr/logging/log.h>

#include "can_bus_driver.hpp"
#include "gpio_overlay.hpp"
#include "message_codec.hpp"
#include "supervisor_manager.hpp"

LOG_MODULE_REGISTER(supervisor_node_main, LOG_LEVEL_INF);

namespace {

using hce::supervisor_node::GpioOverlay;
using hce::supervisor_node::SupervisorManager;

constexpr uint32_t kMonitoringPeriodMs = 1000U;
constexpr size_t kMonitorThreadStackSize = 2048U;
constexpr int kMonitorThreadPriority = 5;

GpioOverlay g_overlay;
hce::supervisor::CanBusDriver* g_can_bus = nullptr;
SupervisorManager* g_supervisor_manager = nullptr;

alignas(hce::supervisor::CanBusDriver) uint8_t g_can_bus_storage[sizeof(hce::supervisor::CanBusDriver)];
alignas(SupervisorManager) uint8_t g_supervisor_manager_storage[sizeof(SupervisorManager)];

/// @brief Copies an incoming CAN-FD frame's data bytes into a fixed-size
///        payload without any heap allocation.
hce::supervisor::MessageCodec::Payload ExtractPayload(const can_frame* frame) {
    hce::supervisor::MessageCodec::Payload payload{};
    for (uint8_t i = 0U; i < hce::supervisor::MessageCodec::kPayloadBytes && i < frame->dlc; ++i) {
        payload[i] = frame->data[i];
    }
    return payload;
}

extern "C" void OnPressureRx(const device* /*dev*/, can_frame* frame, void* /*user_data*/) {
    g_supervisor_manager->OnPressureReceived(ExtractPayload(frame));
}

extern "C" void OnFlowRx(const device* /*dev*/, can_frame* frame, void* /*user_data*/) {
    g_supervisor_manager->OnFlowReceived(ExtractPayload(frame));
}

extern "C" void OnSensorHeartbeatRx(const device* /*dev*/, can_frame* /*frame*/, void* /*user_data*/) {
    g_supervisor_manager->OnSensorHeartbeatReceived();
}

extern "C" void OnMotorHeartbeatRx(const device* /*dev*/, can_frame* /*frame*/, void* /*user_data*/) {
    g_supervisor_manager->OnMotorHeartbeatReceived();
}

void MonitorThreadEntry(void* /*p1*/, void* /*p2*/, void* /*p3*/) {
    while (true) {
        g_supervisor_manager->Tick();
        k_msleep(kMonitoringPeriodMs);
    }
}

K_THREAD_STACK_DEFINE(g_monitor_thread_stack, kMonitorThreadStackSize);
k_thread g_monitor_thread{};

}  // namespace

int main() {
    LOG_INF("Supervisor Node booting");

    if (!g_overlay.Init()) {
        LOG_ERR("gpio_overlay init failed - halting");
        return -1;
    }

    g_can_bus = new (g_can_bus_storage) hce::supervisor::CanBusDriver(g_overlay.CanDevice());
    g_supervisor_manager = new (g_supervisor_manager_storage) SupervisorManager(g_overlay, *g_can_bus);

    if (!g_can_bus->Init()) {
        LOG_ERR("CAN bus init failed - halting");
        return -1;
    }

    g_can_bus->AddRxFilter(hce::supervisor::CanId::kPressure, OnPressureRx, nullptr);
    g_can_bus->AddRxFilter(hce::supervisor::CanId::kFlow, OnFlowRx, nullptr);
    g_can_bus->AddRxFilter(hce::supervisor::CanId::kSensorHeartbeat, OnSensorHeartbeatRx, nullptr);
    g_can_bus->AddRxFilter(hce::supervisor::CanId::kMotorHeartbeat, OnMotorHeartbeatRx, nullptr);

    k_thread_create(&g_monitor_thread, g_monitor_thread_stack, kMonitorThreadStackSize,
                     MonitorThreadEntry, nullptr, nullptr, nullptr, kMonitorThreadPriority, 0,
                     K_NO_WAIT);
    k_thread_name_set(&g_monitor_thread, "supervisor_monitor");

    LOG_INF("Supervisor Node running");
    return 0;
}
```

## include/heartbeat_monitor.hpp
```c
/// @file heartbeat_monitor.hpp
/// @brief Tracks liveness of the Sensor Node and Motor Node heartbeats.
///        A node is declared faulted after three consecutive missed
///        heartbeats (3000 ms at the 1000 ms heartbeat period).
#pragma once

#include <cstdint>

namespace hce::supervisor_node {

/// @brief Per-remote-node liveness tracker.
class NodeLivenessTracker {
public:
    static constexpr uint8_t kMaxConsecutiveMisses = 3U;

    /// @brief Call when a heartbeat frame is received from this node.
    void OnHeartbeatReceived();

    /// @brief Call once per supervisor monitoring tick (1000 ms) to age
    ///        out the current window and evaluate for missed heartbeats.
    void OnMonitoringTick();

    /// @brief true if the node has missed kMaxConsecutiveMisses in a row.
    bool IsFaulted() const { return consecutive_misses_ >= kMaxConsecutiveMisses; }

private:
    uint8_t consecutive_misses_ = 0U;
    bool received_since_last_tick_ = false;
};

/// @brief Aggregates liveness for both remote nodes the Supervisor watches.
class HeartbeatMonitor {
public:
    void OnSensorHeartbeatReceived() { sensor_tracker_.OnHeartbeatReceived(); }
    void OnMotorHeartbeatReceived() { motor_tracker_.OnHeartbeatReceived(); }

    /// @brief Call once per 1000 ms supervisor monitoring tick.
    void OnMonitoringTick();

    bool IsSensorNodeFaulted() const { return sensor_tracker_.IsFaulted(); }
    bool IsMotorNodeFaulted() const { return motor_tracker_.IsFaulted(); }

private:
    NodeLivenessTracker sensor_tracker_;
    NodeLivenessTracker motor_tracker_;
};

}  // namespace hce::supervisor_node
```

## include/supervisor_manager.hpp
```c
/// @file supervisor_manager.hpp
/// @brief Mediator between CAN RX (pressure/flow/heartbeats), alarm_logic,
///        heartbeat_monitor and CAN TX (RUN/STOP). Implements the Mediator
///        design pattern (Rule 4): CAN input handling, fault evaluation and
///        command dispatch never reference each other directly, only
///        through SupervisorManager.
#pragma once

#include <cstdint>

#include "alarm_logic.hpp"
#include "can_bus_driver.hpp"
#include "gpio_overlay.hpp"
#include "heartbeat_monitor.hpp"
#include "message_codec.hpp"

namespace hce::supervisor_node {

/// @brief Supervisor RUN/STOP output state.
enum class SupervisorState : uint8_t {
    kRun = 0U,
    kStop = 1U,
};

/// @brief Top-level Supervisor Node coordinator.
class SupervisorManager {
public:
    SupervisorManager(GpioOverlay& overlay, hce::supervisor::ICanBusDriver& can_bus);

    // ---- CAN RX handlers (called from ISR-safe deferred context) --------
    void OnPressureReceived(const hce::supervisor::MessageCodec::Payload& payload);
    void OnFlowReceived(const hce::supervisor::MessageCodec::Payload& payload);
    void OnSensorHeartbeatReceived();
    void OnMotorHeartbeatReceived();

    /// @brief Evaluate fault logic and drive alarm LED + RUN/STOP CAN
    ///        output. Intended to be called every 1000 ms (Supervisor
    ///        Monitoring period) from a dedicated thread.
    void Tick();

    SupervisorState State() const { return state_; }

private:
    void TransmitStopCommand();
    void TransmitRunCommand();

    GpioOverlay& overlay_;
    hce::supervisor::ICanBusDriver& can_bus_;
    HeartbeatMonitor heartbeat_monitor_;
    AlarmLogic alarm_logic_;

    float latest_pressure_pa_ = 0.0F;
    bool pressure_valid_ = false;
    float latest_flow_lpm_ = 0.0F;
    bool flow_valid_ = false;

    SupervisorState state_ = SupervisorState::kStop;

    static constexpr uint32_t kDefaultRunStepRateHz = 400U;
};

}  // namespace hce::supervisor_node
```

## src/heartbeat_monitor.cpp
```c
#include "heartbeat_monitor.hpp"

#include <zephyr/logging/log.h>

LOG_MODULE_REGISTER(heartbeat_monitor, LOG_LEVEL_INF);

namespace hce::supervisor_node {

void NodeLivenessTracker::OnHeartbeatReceived() {
    received_since_last_tick_ = true;
}

void NodeLivenessTracker::OnMonitoringTick() {
    const bool was_faulted = IsFaulted();
    if (received_since_last_tick_) {
        consecutive_misses_ = 0U;
    } else if (consecutive_misses_ < kMaxConsecutiveMisses) {
        ++consecutive_misses_;
    }
    received_since_last_tick_ = false;

    if (IsFaulted() != was_faulted) {
        LOG_INF("LIVENESS -> %s (consecutive_misses=%u)", IsFaulted() ? "FAULTED" : "OK",
                consecutive_misses_);
    }
}

void HeartbeatMonitor::OnMonitoringTick() {
    sensor_tracker_.OnMonitoringTick();
    motor_tracker_.OnMonitoringTick();
}

}  // namespace hce::supervisor_node
```

## src/supervisor_manager.cpp
```c
#include "supervisor_manager.hpp"

#include <zephyr/logging/log.h>

LOG_MODULE_REGISTER(supervisor_manager, LOG_LEVEL_INF);

namespace hce::supervisor_node {

SupervisorManager::SupervisorManager(GpioOverlay& overlay, hce::supervisor::ICanBusDriver& can_bus)
    : overlay_(overlay), can_bus_(can_bus) {}

void SupervisorManager::OnPressureReceived(const hce::supervisor::MessageCodec::Payload& payload) {
    const hce::supervisor::PressureMessage msg = hce::supervisor::MessageCodec::DecodePressure(payload);
    latest_pressure_pa_ = msg.pressure_pa;
    pressure_valid_ = true;

    LOG_INF("RX Pressure: pressure_pa=%.2f sequence=%u", static_cast<double>(msg.pressure_pa),
            msg.sequence);
}

void SupervisorManager::OnFlowReceived(const hce::supervisor::MessageCodec::Payload& payload) {
    const hce::supervisor::FlowMessage msg = hce::supervisor::MessageCodec::DecodeFlow(payload);
    latest_flow_lpm_ = msg.flow_lpm;
    flow_valid_ = true;

    LOG_INF("RX Flow: flow_lpm=%.2f sequence=%u", static_cast<double>(msg.flow_lpm), msg.sequence);
}

void SupervisorManager::OnSensorHeartbeatReceived() {
    heartbeat_monitor_.OnSensorHeartbeatReceived();
    LOG_INF("RX Heartbeat: node=sensor");
}

void SupervisorManager::OnMotorHeartbeatReceived() {
    heartbeat_monitor_.OnMotorHeartbeatReceived();
    LOG_INF("RX Heartbeat: node=motor");
}

void SupervisorManager::TransmitStopCommand() {
    hce::supervisor::StopCommandMessage msg{};
    msg.reserved = 0U;
    const hce::supervisor::MessageCodec::Payload payload = hce::supervisor::MessageCodec::EncodeStopCommand(msg);
    can_bus_.Send(hce::supervisor::CanId::kStopCommand, payload.data(),
                   hce::supervisor::MessageCodec::kPayloadBytes);

    LOG_INF("TX StopCommand");
}

void SupervisorManager::TransmitRunCommand() {
    hce::supervisor::RunCommandMessage msg{};
    msg.step_rate_hz = kDefaultRunStepRateHz;
    msg.direction = 0U;
    const hce::supervisor::MessageCodec::Payload payload = hce::supervisor::MessageCodec::EncodeRunCommand(msg);
    can_bus_.Send(hce::supervisor::CanId::kRunCommand, payload.data(),
                   hce::supervisor::MessageCodec::kPayloadBytes);

    LOG_INF("TX RunCommand: step_rate_hz=%u direction=FWD", msg.step_rate_hz);
}

void SupervisorManager::Tick() {
    heartbeat_monitor_.OnMonitoringTick();

    AlarmInputs inputs{};
    inputs.pressure_pa = latest_pressure_pa_;
    inputs.pressure_valid = pressure_valid_;
    inputs.flow_lpm = latest_flow_lpm_;
    inputs.flow_valid = flow_valid_;
    inputs.sensor_heartbeat_faulted = heartbeat_monitor_.IsSensorNodeFaulted();
    inputs.motor_heartbeat_faulted = heartbeat_monitor_.IsMotorNodeFaulted();

    const bool faulted = alarm_logic_.Evaluate(inputs);
    overlay_.SetAlarmLed(faulted);

    const SupervisorState new_state = faulted ? SupervisorState::kStop : SupervisorState::kRun;
    if (new_state != state_) {
        LOG_INF("STATE -> %s", (new_state == SupervisorState::kStop) ? "STOP" : "RUN");
    }
    if (new_state != state_ || faulted) {
        // STOP is re-broadcast every tick while faulted (fail-safe,
        // handles a Motor Node that boots or reconnects mid-fault).
        if (new_state == SupervisorState::kStop) {
            TransmitStopCommand();
        } else {
            TransmitRunCommand();
        }
    }
    state_ = new_state;
}

}  // namespace hce::supervisor_node
```
