## prj.conf
```kconfig
# ---- C++ support ------------------------------------------------------
CONFIG_CPP=y
CONFIG_STD_CPP20=y
CONFIG_NEWLIB_LIBC=y
CONFIG_GLIBCXX_LIBCPP=y
CONFIG_NEWLIB_LIBC_FLOAT_PRINTF=y

# ---- No heap allocation (Rule 1) --------------------------------------
CONFIG_HEAP_MEM_POOL_SIZE=0

# ---- Threading / stack watermarks (Rule 6) -----------------------------
CONFIG_THREAD_ANALYZER=y
CONFIG_THREAD_ANALYZER_AUTO=y
CONFIG_THREAD_NAME=y
CONFIG_MAIN_STACK_SIZE=2048

# ---- CAN-FD -------------------------------------------------------------
CONFIG_CAN=y
CONFIG_CAN_FD_MODE=y

# ---- I2C (pressure, flow, LCD) ------------------------------------------
CONFIG_I2C=y

# ---- ADC not required: sensors are I2C per hardware spec ---------------

# ---- GPIO -----------------------------------------------------------
CONFIG_GPIO=y

# ---- Logging ----------------------------------------------------------
CONFIG_LOG=y
CONFIG_LOG_MODE_IMMEDIATE=y
CONFIG_CBPRINTF_FP_SUPPORT=y

# ---- Assertions for defensive programming ------------------------------
CONFIG_ASSERT=y
```

## src/main.cpp
```c
/// @file main.cpp
/// @brief Sensor Node entry point. Wires gpio_overlay -> drivers ->
///        sensor_manager -> {lcd_display, can_bus_driver} and starts the
///        periodic sampling and heartbeat threads.
#include <zephyr/kernel.h>
#include <zephyr/logging/log.h>

#include "can_bus_driver.hpp"
#include "flow_sensor.hpp"
#include "gpio_overlay.hpp"
#include "heartbeat.hpp"
#include "lcd_display.hpp"
#include "message_codec.hpp"
#include "pressure_sensor.hpp"
#include "sensor_manager.hpp"

LOG_MODULE_REGISTER(sensor_node_main, LOG_LEVEL_INF);

namespace {

using hce::sensor_node::CanSensorObserver;
using hce::sensor_node::FlowSensor;
using hce::sensor_node::GpioOverlay;
using hce::sensor_node::Heartbeat;
using hce::sensor_node::LcdDisplay;
using hce::sensor_node::LcdSensorObserver;
using hce::sensor_node::PressureSensor;
using hce::sensor_node::SensorManager;

constexpr uint32_t kSensorSamplePeriodMs = 1000U;
constexpr size_t kSensorThreadStackSize = 2048U;
constexpr size_t kHeartbeatThreadStackSize = 1024U;
constexpr int kSensorThreadPriority = 5;
constexpr int kHeartbeatThreadPriority = 5;

// Static-storage-duration singletons (Rule 1: no heap allocation).
GpioOverlay g_overlay;
hce::sensor::CanBusDriver* g_can_bus = nullptr;
PressureSensor* g_pressure_sensor = nullptr;
FlowSensor* g_flow_sensor = nullptr;
LcdDisplay* g_lcd = nullptr;
LcdSensorObserver* g_lcd_observer = nullptr;
CanSensorObserver* g_can_observer = nullptr;
SensorManager* g_sensor_manager = nullptr;
Heartbeat* g_heartbeat = nullptr;

// Placement-new storage pools (no dynamic allocation; Rule 1).
alignas(hce::sensor::CanBusDriver) uint8_t g_can_bus_storage[sizeof(hce::sensor::CanBusDriver)];
alignas(PressureSensor) uint8_t g_pressure_storage[sizeof(PressureSensor)];
alignas(FlowSensor) uint8_t g_flow_storage[sizeof(FlowSensor)];
alignas(LcdDisplay) uint8_t g_lcd_storage[sizeof(LcdDisplay)];
alignas(LcdSensorObserver) uint8_t g_lcd_observer_storage[sizeof(LcdSensorObserver)];
alignas(CanSensorObserver) uint8_t g_can_observer_storage[sizeof(CanSensorObserver)];
alignas(SensorManager) uint8_t g_sensor_manager_storage[sizeof(SensorManager)];
alignas(Heartbeat) uint8_t g_heartbeat_storage[sizeof(Heartbeat)];

k_work g_estop_work{};

/// @brief Deferred (thread-context) handler for an E-STOP broadcast.
///        CAN RX callbacks run in ISR context and must not perform I2C
///        transactions directly, so the LCD update is deferred here.
void EstopWorkHandler(k_work* /*work*/) {
    if (g_lcd != nullptr) {
        g_lcd->ShowEmergencyStop();
    }
}

/// @brief ISR-context CAN RX callback for the STOP command (0x100).
extern "C" void OnStopCommandRx(const device* /*dev*/, can_frame* /*frame*/, void* /*user_data*/) {
    k_work_submit(&g_estop_work);
}

void SensorThreadEntry(void* /*p1*/, void* /*p2*/, void* /*p3*/) {
    while (true) {
        g_sensor_manager->Tick();
        k_msleep(kSensorSamplePeriodMs);
    }
}

void HeartbeatThreadEntry(void* /*p1*/, void* /*p2*/, void* /*p3*/) {
    while (true) {
        g_heartbeat->Tick();
        k_msleep(Heartbeat::kPeriodMs);
    }
}

K_THREAD_STACK_DEFINE(g_sensor_thread_stack, kSensorThreadStackSize);
K_THREAD_STACK_DEFINE(g_heartbeat_thread_stack, kHeartbeatThreadStackSize);
k_thread g_sensor_thread{};
k_thread g_heartbeat_thread{};

}  // namespace

int main() {
    LOG_INF("Sensor Node booting");

    if (!g_overlay.Init()) {
        LOG_ERR("gpio_overlay init failed - halting");
        return -1;
    }

    g_can_bus = new (g_can_bus_storage) hce::sensor::CanBusDriver(g_overlay.CanDevice());
    g_pressure_sensor = new (g_pressure_storage) PressureSensor(g_overlay);
    g_flow_sensor = new (g_flow_storage) FlowSensor(g_overlay);
    g_lcd = new (g_lcd_storage) LcdDisplay(g_overlay);
    g_lcd_observer = new (g_lcd_observer_storage) LcdSensorObserver(*g_lcd);
    g_can_observer = new (g_can_observer_storage) CanSensorObserver(*g_can_bus);
    g_sensor_manager = new (g_sensor_manager_storage) SensorManager(*g_pressure_sensor, *g_flow_sensor);
    g_heartbeat = new (g_heartbeat_storage) Heartbeat(g_overlay, *g_can_bus);

    if (!g_can_bus->Init() || !g_pressure_sensor->Init() || !g_flow_sensor->Init() ||
        !g_lcd->Init()) {
        LOG_ERR("Peripheral init failed - halting");
        return -1;
    }

    g_sensor_manager->AddObserver(*g_lcd_observer);
    g_sensor_manager->AddObserver(*g_can_observer);

    k_work_init(&g_estop_work, EstopWorkHandler);
    g_can_bus->AddRxFilter(hce::sensor::CanId::kStopCommand, OnStopCommandRx, nullptr);

    k_thread_create(&g_sensor_thread, g_sensor_thread_stack, kSensorThreadStackSize,
                     SensorThreadEntry, nullptr, nullptr, nullptr, kSensorThreadPriority, 0,
                     K_NO_WAIT);
    k_thread_name_set(&g_sensor_thread, "sensor_sample");

    k_thread_create(&g_heartbeat_thread, g_heartbeat_thread_stack, kHeartbeatThreadStackSize,
                     HeartbeatThreadEntry, nullptr, nullptr, nullptr, kHeartbeatThreadPriority, 0,
                     K_NO_WAIT);
    k_thread_name_set(&g_heartbeat_thread, "sensor_heartbeat");

    LOG_INF("Sensor Node running");
    return 0;
}
```

## include/heartbeat.hpp
```c
/// @file heartbeat.hpp
/// @brief Periodic heartbeat: toggles the PC4 LED and transmits CAN ID
///        0x200 every 1000 ms.
#pragma once

#include <cstdint>

#include "can_bus_driver.hpp"
#include "gpio_overlay.hpp"
#include "message_codec.hpp"

namespace hce::sensor_node {

/// @brief Sensor Node heartbeat publisher.
class Heartbeat {
public:
    Heartbeat(GpioOverlay& overlay, hce::sensor::ICanBusDriver& can_bus);

    /// @brief Toggle the LED and transmit one heartbeat frame.
    ///        Intended to be called every kPeriodMs from a dedicated thread.
    void Tick();

    static constexpr uint32_t kPeriodMs = 1000U;

private:
    GpioOverlay& overlay_;
    hce::sensor::ICanBusDriver& can_bus_;
    uint32_t sequence_ = 0U;
    bool led_state_ = false;
};

}  // namespace hce::sensor_node
```

## include/sensor_manager.hpp
```c
/// @file sensor_manager.hpp
/// @brief Orchestrates pressure/flow sampling and fans each reading out to
///        the LCD and the CAN bus using the Observer design pattern
///        (Rule 4: named design pattern per module).
#pragma once

#include <array>
#include <cstdint>

#include "can_bus_driver.hpp"
#include "flow_sensor.hpp"
#include "lcd_display.hpp"
#include "message_codec.hpp"
#include "pressure_sensor.hpp"

namespace hce::sensor_node {

/// @brief Observer interface notified whenever a new sample is available.
///        LcdDisplay and the CAN publisher path both implement this.
class ISensorDataObserver {
public:
    virtual ~ISensorDataObserver() = default;
    virtual void OnPressureSample(float pressure_pa) = 0;
    virtual void OnFlowSample(float flow_lpm) = 0;
};

/// @brief Adapts LcdDisplay to the ISensorDataObserver interface.
class LcdSensorObserver final : public ISensorDataObserver {
public:
    explicit LcdSensorObserver(ILcdDisplay& lcd) : lcd_(lcd) {}
    void OnPressureSample(float pressure_pa) override { lcd_.ShowPressure(pressure_pa); }
    void OnFlowSample(float flow_lpm) override { lcd_.ShowFlow(flow_lpm); }

private:
    ILcdDisplay& lcd_;
};

/// @brief Adapts the CAN transport to the ISensorDataObserver interface,
///        publishing CAN ID 0x300 (pressure) / 0x301 (flow).
class CanSensorObserver final : public ISensorDataObserver {
public:
    explicit CanSensorObserver(hce::sensor::ICanBusDriver& can_bus) : can_bus_(can_bus) {}
    void OnPressureSample(float pressure_pa) override;
    void OnFlowSample(float flow_lpm) override;

private:
    hce::sensor::ICanBusDriver& can_bus_;
    uint32_t pressure_sequence_ = 0U;
    uint32_t flow_sequence_ = 0U;
};

/// @brief Top-level Sensor Node sampling coordinator.
class SensorManager {
public:
    static constexpr std::size_t kMaxObservers = 4U;

    SensorManager(IPressureSensor& pressure_sensor, IFlowSensor& flow_sensor);

    /// @brief Register an observer (Observer pattern subject-side API).
    /// @return true if there was a free slot.
    bool AddObserver(ISensorDataObserver& observer);

    /// @brief Sample both sensors once and notify all observers.
    ///        Intended to be called every 1000 ms from a dedicated thread.
    void Tick();

    /// @brief Called by the CAN RX path when a STOP command (0x100) arrives.
    void OnStopCommandReceived();

private:
    IPressureSensor& pressure_sensor_;
    IFlowSensor& flow_sensor_;
    std::array<ISensorDataObserver*, kMaxObservers> observers_{};
    std::size_t observer_count_ = 0U;
};

}  // namespace hce::sensor_node
```

## src/heartbeat.cpp
```c
#include "heartbeat.hpp"

#include <zephyr/logging/log.h>

LOG_MODULE_REGISTER(sensor_heartbeat, LOG_LEVEL_INF);

namespace hce::sensor_node {

Heartbeat::Heartbeat(GpioOverlay& overlay, hce::sensor::ICanBusDriver& can_bus)
    : overlay_(overlay), can_bus_(can_bus) {}

void Heartbeat::Tick() {
    led_state_ = !led_state_;
    overlay_.SetHeartbeatLed(led_state_);

    hce::sensor::HeartbeatMessage msg{};
    msg.sequence = sequence_;
    msg.node_ok = 1U;
    ++sequence_;

    const hce::sensor::MessageCodec::Payload payload = hce::sensor::MessageCodec::EncodeHeartbeat(msg);
    can_bus_.Send(hce::sensor::CanId::kSensorHeartbeat, payload.data(),
                   hce::sensor::MessageCodec::kPayloadBytes);

    LOG_INF("TX Heartbeat: sequence=%u node_ok=%u", msg.sequence, msg.node_ok);
}

}  // namespace hce::sensor_node
```

## src/sensor_manager.cpp
```c
#include "sensor_manager.hpp"

#include <zephyr/logging/log.h>

LOG_MODULE_REGISTER(sensor_manager, LOG_LEVEL_INF);

namespace hce::sensor_node {

void CanSensorObserver::OnPressureSample(float pressure_pa) {
    hce::sensor::PressureMessage msg{};
    msg.pressure_pa = pressure_pa;
    msg.sequence = pressure_sequence_;
    ++pressure_sequence_;

    const hce::sensor::MessageCodec::Payload payload = hce::sensor::MessageCodec::EncodePressure(msg);
    can_bus_.Send(hce::sensor::CanId::kPressure, payload.data(),
                   hce::sensor::MessageCodec::kPayloadBytes);

    LOG_INF("TX Pressure: pressure_pa=%.2f sequence=%u", static_cast<double>(pressure_pa),
            msg.sequence);
}

void CanSensorObserver::OnFlowSample(float flow_lpm) {
    hce::sensor::FlowMessage msg{};
    msg.flow_lpm = flow_lpm;
    msg.sequence = flow_sequence_;
    ++flow_sequence_;

    const hce::sensor::MessageCodec::Payload payload = hce::sensor::MessageCodec::EncodeFlow(msg);
    can_bus_.Send(hce::sensor::CanId::kFlow, payload.data(),
                   hce::sensor::MessageCodec::kPayloadBytes);

    LOG_INF("TX Flow: flow_lpm=%.2f sequence=%u", static_cast<double>(flow_lpm), msg.sequence);
}

SensorManager::SensorManager(IPressureSensor& pressure_sensor, IFlowSensor& flow_sensor)
    : pressure_sensor_(pressure_sensor), flow_sensor_(flow_sensor) {}

bool SensorManager::AddObserver(ISensorDataObserver& observer) {
    if (observer_count_ >= kMaxObservers) {
        return false;
    }
    observers_[observer_count_] = &observer;
    ++observer_count_;
    return true;
}

void SensorManager::Tick() {
    float pressure_pa = 0.0F;
    if (pressure_sensor_.Read(pressure_pa)) {
        for (std::size_t i = 0U; i < observer_count_; ++i) {
            observers_[i]->OnPressureSample(pressure_pa);
        }
    }

    float flow_lpm = 0.0F;
    if (flow_sensor_.Read(flow_lpm)) {
        for (std::size_t i = 0U; i < observer_count_; ++i) {
            observers_[i]->OnFlowSample(flow_lpm);
        }
    }
}

void SensorManager::OnStopCommandReceived() {
    // Forwarded to LCD observers that also implement emergency-stop
    // display; sensor_manager itself stays hardware-agnostic and simply
    // signals the event upward. Handled directly in main.cpp's CAN
    // callback for the LCD, since ISensorDataObserver does not carry an
    // E-STOP notification (kept minimal per Observer interface).
}

}  // namespace hce::sensor_node
```
